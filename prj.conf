## CMakeLists.txt
```
# SPDX-License-Identifier: Apache-2.0

cmake_minimum_required(VERSION 3.20.0)

find_package(Zephyr REQUIRED HINTS $ENV{ZEPHYR_BASE})
project(my_pep_app)

target_sources(app PRIVATE src/main.cpp)
target_include_directories(app PRIVATE src)
```

## prj.conf
```kconfig
CONFIG_CPP=y
CONFIG_GPIO=y
CONFIG_GPIO_EMUL=y
CONFIG_GPIO_INIT_PRIORITY=40
CONFIG_LOG=y
CONFIG_LOG_DEFAULT_LEVEL=4
```

## boards/native_posix.overlay
```dts
/ {
    gpio_input: gpio_input {
        compatible = "gpio-emul";
        gpios = <&gpio0 0 GPIO_PULL_UP>;
        label = "GPIO_INPUT";
    };

    gpio_output: gpio_output {
        compatible = "gpio-emul";
        gpios = <&gpio0 1 GPIO_ACTIVE_HIGH>;
        label = "GPIO_OUTPUT";
    };

};
```

## src/main.cpp
```c
/**
 * @file main.cpp
 * @brief Zephyr application with decoupled hardware access for GPIO input and output.
 *
 */

#include <zephyr/kernel.h>
#include <zephyr/device.h>
#include <zephyr/drivers/gpio.h>
#include <zephyr/sys/util.h>
#include <zephyr/logging/log.h>
#include "gpiohal.hpp"
#include "read_class.hpp"
#include "react_class.hpp"

LOG_MODULE_REGISTER(app, LOG_LEVEL_INF);

// Global mutex to protect GPIO state
struct k_mutex gpio_state_mutex;

// Global state of gpio input
bool gpio_state = false;

// Thread stacks
K_THREAD_STACK_DEFINE(thread_1_stack, 1024); /**< Stack for ReadClass thread */
K_THREAD_STACK_DEFINE(thread_2_stack, 1024); /**< Stack for ReactClass thread */

/**
 * @brief GPIO interrupt callback.
 * 
 * @param dev GPIO device pointer
 * @param cb GPIO callback structure
 * @param pins Triggered pins
 */
void ReadClass::gpio_interrupt_callback(const struct device *dev, struct gpio_callback *cb, uint32_t pins) {
    auto *instance = reinterpret_cast<ReadClass *>(CONTAINER_OF(cb, ReadClass, gpio_cb));
    k_wakeup(instance->thread_id);
}
/**
 * @brief Thread function to process GPIO state changes.
 * 
 * @param arg1 Instance of ReadClass
 * @param arg2 Unused
 * @param arg3 Unused
 */
void ReadClass::thread_handler(void *arg1, void *arg2, void *arg3) {
    auto *self = static_cast<ReadClass *>(arg1);
    self->process_gpio_state();
}

/**
 * @brief Process GPIO state changes with debouncing.
 */
void ReadClass::process_gpio_state() {
    while (true) {
        k_sleep(K_FOREVER);

        bool current_state = gpio_input.read();
        k_msleep(DEBOUNCE_DELAY_MS); 
        bool stable_state = gpio_input.read();

        if (current_state == stable_state && stable_state != last_state) {
            k_mutex_lock(&gpio_state_mutex, K_FOREVER);
            gpio_state = stable_state;
            k_mutex_unlock(&gpio_state_mutex);

            LOG_INF("GPIO state changed: %s\n", stable_state ? "HIGH" : "LOW");
            last_state = stable_state;
        }
    }
}

/**
 * @brief Constructor initializes the GPIO input.
 * 
 * @param gpio Reference to GPIO HAL instance
 */
ReadClass::ReadClass(GpioHal &gpio) : gpio_input(gpio), thread_id(nullptr), last_state(false) {}

/**
 * @brief Initialize the GPIO input and interrupt.
 * 
 * @return int 0 on success, error code otherwise
 */
int ReadClass::init() {
    int ret = gpio_input.init(GPIO_INPUT | GPIO_PULL_UP);
    if (ret) return ret;

    ret = gpio_input.configure_interrupt(GPIO_INT_EDGE_BOTH);
    if (ret) return ret;

    gpio_init_callback(&gpio_cb, gpio_interrupt_callback, BIT(gpio_input.get_spec().pin));
    gpio_input.add_callback(&gpio_cb);

    thread_id = k_thread_create(&thread_data, thread_1_stack, K_THREAD_STACK_SIZEOF(thread_1_stack),
                                thread_handler, this, nullptr, nullptr, READ_THREAD_PRIORITY, 0, K_NO_WAIT);
    return 0;
}

/**
 * @brief Initialize the GPIO input and interrupt.
 * 
 * @return int 0 on success, error code otherwise
 */
void ReadClass::interrupt_change(bool state) {
    gpio_state = state;
}

/**
 * @brief Thread function to control LED output.
 * 
 * @param arg1 Instance of ReactClass
 * @param arg2 Unused
 * @param arg3 Unused
 */
void ReactClass::thread_handler(void *arg1, void *arg2, void *arg3) {
    auto *self = static_cast<ReactClass *>(arg1);
    while (true) {
        self->control_led();
    }
}

/**
 * @brief Control the LED based on GPIO state.
 */
void ReactClass::control_led() {
    k_msleep(100); // Periodic check

    k_mutex_lock(&gpio_state_mutex, K_FOREVER);
    bool state = gpio_state;
    k_mutex_unlock(&gpio_state_mutex);

    if (state != previous_state) {
        if (state) {
            for (int i = 0; i < 3; ++i) {
                gpio_output.set(true);
                LOG_INF("LED is ON!\n");
                k_msleep(LED_BLINK_DELAY_MS);
                gpio_output.set(false);
                LOG_INF("LED is OFF!\n");
                k_msleep(LED_BLINK_DELAY_MS);
            }
        } else {
            gpio_output.set(true);
            LOG_INF("LED is ON!\n");
            k_msleep(LED_ON_TIME_MS);
            gpio_output.set(false);
            LOG_INF("LED is OFF!\n");
        }
        previous_state = state;
    } 
}

/**
 * @brief Constructor initializes the GPIO output.
 * 
 * @param gpio Reference to GPIO HAL instance
 */
ReactClass::ReactClass(GpioHal &gpio) : gpio_output(gpio), thread_id(nullptr) {}

/**
 * @brief Initialize the GPIO output.
 * 
 * @return int 0 on success, error code otherwise
 */
int ReactClass::init() {
    int ret = gpio_output.init(GPIO_OUTPUT);
    if (ret) return ret;

    thread_id = k_thread_create(&thread_data, thread_2_stack, K_THREAD_STACK_SIZEOF(thread_2_stack),
                                thread_handler, this, nullptr, nullptr, REACT_THREAD_PRIORITY, 0, K_NO_WAIT);
    return 0;
}

void ReactClass::simulate_state_change(bool state) {
    gpio_state = state;
    control_led(); 
}


// Main Application
int main(void) {
    k_mutex_init(&gpio_state_mutex);

    GpioHal gpio_input(GPIO_DT_SPEC_GET_OR(GPIO_INPUT_NODE, gpios, {0}));
    GpioHal gpio_output(GPIO_DT_SPEC_GET_OR(DT_ALIAS(led0), gpios, {0}));

    ReadClass read_class(gpio_input);
    ReactClass react_class(gpio_output);

    if (read_class.init() != 0 || react_class.init() != 0) {
        LOG_ERR("Failed to initialize GPIO components\n");
        return -1;
    }
    return 0;
}
```

## src/gpiohal.hpp
```c
#ifndef GPIOHAL_HPP
#define GPIOHAL_HPP

#include <zephyr/drivers/gpio.h>
#include <zephyr/logging/log.h>


/**
 * @class GpioHal
 * @brief Abstract GPIO access for both input and output devices.
 */
class GpioHal {
private:
    struct gpio_dt_spec gpio_spec; ///< GPIO device specification

public:
    explicit GpioHal(const struct gpio_dt_spec &spec) : gpio_spec(spec) {}

    /**
     * @brief Initialize the GPIO pin.
     * 
     * @param flags GPIO configuration flags
     * @return int 0 on success, error code otherwise
     */
    int init(gpio_flags_t flags) {
        if (!gpio_is_ready_dt(&gpio_spec)) {
            printk("Error: GPIO device %s not ready\n", gpio_spec.port->name);
            return -ENODEV;
        }
        return gpio_pin_configure_dt(&gpio_spec, flags);
    }

    /**
     * @brief Read the GPIO pin state.
     * 
     * @return true if pin is high, false otherwise
     */
    bool read() const { return gpio_pin_get_dt(&gpio_spec); }

    /**
     * @brief Set the GPIO pin state.
     * 
     * @param state true to set high, false to set low
     * @return int 0 on success, error code otherwise
     */
    int set(bool state) const { return gpio_pin_set_dt(&gpio_spec, state); }

    /**
     * @brief Add an interrupt callback to the GPIO pin.
     * 
     * @param callback GPIO callback
     * @return int 0 on success, error code otherwise
     */
    int add_callback(struct gpio_callback *callback) {
        gpio_add_callback(gpio_spec.port, callback);
        return 0;
    }

    /**
     * @brief Configure the GPIO pin interrupt.
     * 
     * @param flags Interrupt configuration flags
     * @return int 0 on success, error code otherwise
     */
    int configure_interrupt(gpio_flags_t flags) { return gpio_pin_interrupt_configure_dt(&gpio_spec, flags); }

    const struct gpio_dt_spec &get_spec() const { return gpio_spec; }
};

#endif // GPIOHAL_HPP
```

## src/react_class.hpp
```c
#ifndef REACT_CLASS_HPP
#define REACT_CLASS_HPP

#include <zephyr/kernel.h>
#include "gpiohal.hpp"


/// LED blink delay in milliseconds
constexpr int LED_BLINK_DELAY_MS = 100;

/// LED on duration in milliseconds
constexpr int LED_ON_TIME_MS = 500;

/// Priority for the ReactClass thread
constexpr int REACT_THREAD_PRIORITY = 2;

/// Thread stack size for the ReactClass thread
constexpr size_t REACT_THREAD_STACK_SIZE = 1024;

extern k_mutex gpio_state_mutex; ///< Shared mutex for GPIO state
extern bool gpio_state;          ///< Shared GPIO state

/**
 * @class ReactClass
 * @brief Class responsible for reacting to GPIO state changes and controlling an LED.
 */
class ReactClass {
private:
    GpioHal &gpio_output; ///< GPIO output abstraction
    k_tid_t thread_id;    ///< Thread ID for the reacting thread
    bool previous_state;  ///< Last known GPIO state

    struct k_thread thread_data; ///< Thread data structure
    static K_THREAD_STACK_DEFINE(thread_stack, REACT_THREAD_STACK_SIZE);

    /**
     * @brief Thread function to control LED output.
     * 
     * @param arg1 Instance of ReactClass
     * @param arg2 Unused
     * @param arg3 Unused
     */
    static void thread_handler(void *arg1, void *arg2, void *arg3);

    /**
     * @brief Control the LED based on GPIO state.
     */
    void control_led();

public:
    /**
     * @brief Constructor initializes the GPIO output.
     * 
     * @param gpio Reference to GPIO HAL instance
     */
    ReactClass(GpioHal &gpio);

    /**
     * @brief Initialize the GPIO output.
     * 
     * @return int 0 on success, error code otherwise
     */
    int init();

    void simulate_state_change(bool state);

};

#endif // REACT_CLASS_HPP
```

## src/read_class.hpp
```c
#ifndef READ_CLASS_HPP
#define READ_CLASS_HPP

#include <zephyr/kernel.h>
#include "gpiohal.hpp"

/// Debounce delay in milliseconds
const int DEBOUNCE_DELAY_MS = 50;

/// Priority for the ReadClass thread
const int READ_THREAD_PRIORITY = 1;

/// Thread stack size for the ReadClass thread
const size_t READ_THREAD_STACK_SIZE = 1024;

extern k_mutex gpio_state_mutex; ///< Shared mutex for GPIO state
extern bool gpio_state;          ///< Shared GPIO state

/**
 * @class ReadClass
 * @brief Class responsible for reading GPIO input and handling its state.
 */
class ReadClass {
private:
    GpioHal &gpio_input;         ///< GPIO input abstraction
    struct gpio_callback gpio_cb; ///< GPIO callback structure
    k_tid_t thread_id;           ///< Thread ID for the reading thread
    bool last_state;             ///< Last stable GPIO state

    struct k_thread thread_data; ///< Thread data structure
    static K_THREAD_STACK_DEFINE(thread_stack, READ_THREAD_STACK_SIZE);

    /**
     * @brief GPIO interrupt callback.
     * 
     * @param dev GPIO device pointer
     * @param cb GPIO callback 
     * @param pins Triggered pins
     */
    static void gpio_interrupt_callback(const struct device *dev, struct gpio_callback *cb, uint32_t pins);

    /**
     * @brief Thread function to process GPIO state changes.
     * 
     * @param arg1 Instance of ReadClass
     * @param arg2 Unused
     * @param arg3 Unused
     */
    static void thread_handler(void *arg1, void *arg2, void *arg3);

    /**
     * @brief Process GPIO state changes with debouncing.
     */
    void process_gpio_state();

public:
    /**
     * @brief Constructor initializes the GPIO input.
     * 
     * @param gpio Reference to GPIO HAL instance
     */
    ReadClass(GpioHal &gpio);

    /**
     * @brief Initialize the GPIO input and interrupt.
     * 
     * @return int 0 on success, error code otherwise
     */
    int init();

    /**
     * @brief Initialize the GPIO input and interrupt.
     * 
     * @return int 0 on success, error code otherwise
     */
    void interrupt_change(bool state);

};

#endif // READ_CLASS_HPP
```
